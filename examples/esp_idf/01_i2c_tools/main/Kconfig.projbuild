## examples/esp_idf/01_i2c_tools/main/Kconfig.projbuild
```kconfig
menu "Example Configuration"

    config EXAMPLE_STORE_HISTORY
        bool "Store command history in flash"
        default y
        help
            Linenoise line editing library provides functions to save and load
            command history. If this option is enabled, initalizes a FAT filesystem
            and uses it to store command history.

    config EXAMPLE_I2C_MASTER_SCL
        int "SCL GPIO Num"
        default 19 if IDF_TARGET_ESP32
        default 8
        help
            GPIO number for I2C Master clock line.

    config EXAMPLE_I2C_MASTER_SDA
        int "SDA GPIO Num"
        default 18 if IDF_TARGET_ESP32
        default 7
        help
            GPIO number for I2C Master data line.

    choice EXAMPLE_I2C_DEFAULT_SPEED
        bool "Default I2C speed"
        default EXAMPLE_I2C_SPEED_100KHZ
        help
            Select the I2C clock speed used immediately after boot.

        config EXAMPLE_I2C_SPEED_100KHZ
            bool "100 kHz (standard mode)"

        config EXAMPLE_I2C_SPEED_400KHZ
            bool "400 kHz (fast mode)"
    endchoice

    config EXAMPLE_I2C_WAVEFORM_ADDRESS
        hex "Waveform test slave address"
        range 0x08 0x77
        default 0x50
        help
            7-bit address used by the continuous waveform test.

    config EXAMPLE_I2C_WAVEFORM_DATA
        hex "Waveform test data"
        range 0x00 0xff
        default 0x55
        help
            Byte sent continuously after the address. ACK checking is disabled
            so a waveform is generated even when no slave is connected.

    config EXAMPLE_I2C_WAVEFORM_INTERVAL_MS
        int "Waveform test interval (ms)"
        range 1 10000
        default 20
        help
            Delay between continuous I2C waveform transactions.

endmenu
```

## examples/esp_idf/03_wifistation/main/Kconfig.projbuild
```kconfig
menu "Example Configuration"

    config ESP_WIFI_SSID
        string "WiFi SSID"
        default "myssid"
        help
            SSID for station mode or the SoftAP network name.

    config ESP_WIFI_PASSWORD
        string "WiFi Password"
        default "mypassword"
        help
            WiFi password for station mode or SoftAP mode.

    config ESP_WIFI_SOFTAP_MODE
        bool "Run in SoftAP mode"
        default n
        help
            Create a WiFi hotspot for phone-based signal quality testing.

    config ESP_WIFI_AP_CHANNEL
        int "SoftAP channel"
        range 1 13
        default 1
        depends on ESP_WIFI_SOFTAP_MODE

    config ESP_WIFI_AP_MAX_CONNECTIONS
        int "SoftAP maximum connections"
        range 1 10
        default 4
        depends on ESP_WIFI_SOFTAP_MODE

    choice ESP_WIFI_SAE_MODE
        prompt "WPA3 SAE mode selection"
        default ESP_WPA3_SAE_PWE_BOTH
        help
            Select mode for SAE as Hunt and Peck, H2E or both.
        config ESP_WPA3_SAE_PWE_HUNT_AND_PECK
            bool "HUNT AND PECK"
        config ESP_WPA3_SAE_PWE_HASH_TO_ELEMENT
            bool "H2E"
        config ESP_WPA3_SAE_PWE_BOTH
            bool "BOTH"
    endchoice

    config ESP_WIFI_PW_ID
        string "PASSWORD IDENTIFIER"
        depends on ESP_WPA3_SAE_PWE_HASH_TO_ELEMENT || ESP_WPA3_SAE_PWE_BOTH
        default ""

    config ESP_MAXIMUM_RETRY
        int "Maximum retry"
        default 5

    choice ESP_WIFI_SCAN_AUTH_MODE_THRESHOLD
        prompt "WiFi Scan auth mode threshold"
        default ESP_WIFI_AUTH_WPA2_PSK
        config ESP_WIFI_AUTH_OPEN
            bool "OPEN"
        config ESP_WIFI_AUTH_WEP
            bool "WEP"
        config ESP_WIFI_AUTH_WPA_PSK
            bool "WPA PSK"
        config ESP_WIFI_AUTH_WPA2_PSK
            bool "WPA2 PSK"
        config ESP_WIFI_AUTH_WPA_WPA2_PSK
            bool "WPA/WPA2 PSK"
        config ESP_WIFI_AUTH_WPA3_PSK
            bool "WPA3 PSK"
        config ESP_WIFI_AUTH_WPA2_WPA3_PSK
            bool "WPA2/WPA3 PSK"
        config ESP_WIFI_AUTH_WAPI_PSK
            bool "WAPI PSK"
    endchoice

endmenu
```

## examples/esp_idf/12_bt_controller_mac_addr/main/Kconfig.projbuild
```kconfig
menu "Example Configuration"

    config EXAMPLE_UPDATE_BT_MAC_ADDRESS
        bool "Update BT Controller MAC address before init"
        default n
        help
            Temporarily update the co-processor BT controller MAC address
            before initializing the Hosted BT controller. The update reverts
            after reset.

    config EXAMPLE_BT_MAC_ADDRESS
        string "BT Controller MAC address"
        depends on EXAMPLE_UPDATE_BT_MAC_ADDRESS
        default "08:3A:8D:01:01:01"
        help
            Six-byte MAC address in XX:XX:XX:XX:XX:XX format.

endmenu
```

## firmware/brookesia/sdkconfig.defaults
```kconfig
CONFIG_IDF_TARGET="esp32p4"
CONFIG_IDF_EXPERIMENTAL_FEATURES=y
CONFIG_COMPILER_OPTIMIZATION_PERF=y

# Flash / partitions
CONFIG_ESPTOOLPY_FLASHMODE_QIO=y
CONFIG_ESPTOOLPY_FLASHSIZE_16MB=y
CONFIG_PARTITION_TABLE_CUSTOM=y
CONFIG_PARTITION_TABLE_OFFSET=0x9000

# PSRAM: run code/rodata from PSRAM and keep internal RAM for DMA and the GUI.
CONFIG_SPIRAM=y
CONFIG_SPIRAM_MODE_HEX=y
CONFIG_SPIRAM_FETCH_INSTRUCTIONS=y
CONFIG_SPIRAM_RODATA=y
CONFIG_SPIRAM_XIP_FROM_PSRAM=y
CONFIG_SPIRAM_MALLOC_ALWAYSINTERNAL=0
CONFIG_SPIRAM_MALLOC_RESERVE_INTERNAL=4096
CONFIG_SPIRAM_MEMTEST=y
CONFIG_SPIRAM_SPEED_250M=y

# Console
CONFIG_ESP_CONSOLE_UART_CUSTOM=y
CONFIG_ESP_CONSOLE_UART_BAUDRATE=2000000

# System
CONFIG_ESP_SYSTEM_EVENT_TASK_STACK_SIZE=4096
CONFIG_ESP_MAIN_TASK_STACK_SIZE=8192
CONFIG_FREERTOS_HZ=1000
CONFIG_VFS_MAX_COUNT=20

# LVGL task/tick are owned by esp_lvgl_adapter; VideoPlayer uses adapter Dummy Draw.
CONFIG_LV_OS_FREERTOS=y
CONFIG_LV_USE_CLIB_MALLOC=y
CONFIG_LV_USE_CLIB_STRING=y
CONFIG_LV_USE_CLIB_SPRINTF=y
CONFIG_LV_DEF_REFR_PERIOD=15
CONFIG_LV_OBJ_STYLE_CACHE=y
CONFIG_LV_DRAW_SW_DRAW_UNIT_CNT=2
CONFIG_LV_USE_LOG=y
CONFIG_LV_LOG_PRINTF=y
CONFIG_LV_USE_SNAPSHOT=y
CONFIG_LV_BUILD_EXAMPLES=n

# OV5647 camera sensor over MIPI CSI.
CONFIG_CAMERA_OV5647=y
CONFIG_CAMERA_OV5647_AUTO_DETECT_MIPI_INTERFACE_SENSOR=y
CONFIG_CAMERA_OV5647_MIPI_RAW8_800X800_50FPS=y
CONFIG_CAMERA_OV5647_MIPI_DEFAULT_FMT_RAW8_800X800_50FPS=y
CONFIG_CAMERA_OV5647_CSI_LINESYNC_ENABLE=y

# xiaozhi-fonts renders emoji glyphs through LVGL's image-font backend.
CONFIG_LV_USE_IMGFONT=y

# brookesia_core resolves fonts by pixel size at runtime, so keep the full
# Montserrat range it can request.
CONFIG_LV_FONT_MONTSERRAT_8=y
CONFIG_LV_FONT_MONTSERRAT_10=y
CONFIG_LV_FONT_MONTSERRAT_12=y
CONFIG_LV_FONT_MONTSERRAT_16=y
CONFIG_LV_FONT_MONTSERRAT_18=y
CONFIG_LV_FONT_MONTSERRAT_20=y
CONFIG_LV_FONT_MONTSERRAT_22=y
CONFIG_LV_FONT_MONTSERRAT_24=y
CONFIG_LV_FONT_MONTSERRAT_26=y
CONFIG_LV_FONT_MONTSERRAT_28=y
CONFIG_LV_FONT_MONTSERRAT_30=y
CONFIG_LV_FONT_MONTSERRAT_32=y
CONFIG_LV_FONT_MONTSERRAT_34=y
CONFIG_LV_FONT_MONTSERRAT_36=y
CONFIG_LV_FONT_MONTSERRAT_38=y
CONFIG_LV_FONT_MONTSERRAT_40=y
CONFIG_LV_FONT_MONTSERRAT_42=y
CONFIG_LV_FONT_MONTSERRAT_44=y
CONFIG_LV_FONT_FMT_TXT_LARGE=y
CONFIG_LV_USE_FONT_COMPRESSED=y

# ESP-Brookesia core: phone system and the StorageNVS service
CONFIG_ESP_BROOKESIA_ENABLE_AI_FRAMEWORK=n
CONFIG_ESP_BROOKESIA_GUI_ENABLE_ANIM_PLAYER=n
CONFIG_ESP_BROOKESIA_ENABLE_SERVICES=y
CONFIG_ESP_BROOKESIA_SERVICES_ENABLE_STORAGE_NVS=y
CONFIG_ESP_BROOKESIA_SYSTEMS_ENABLE_SPEAKER=n
CONFIG_BOOST_MATH_ENABLED=n
CONFIG_BOOST_SERIALIZATION_ENABLED=n
CONFIG_BOOST_THREAD_ENABLED=y

# ESP-Hosted: on-board ESP32-C5 over SDIO slot 1
CONFIG_ESP_HOSTED=y
CONFIG_ESP_HOSTED_HOST_FEAT_WIFI=y
CONFIG_SLAVE_IDF_TARGET_ESP32C5=y
CONFIG_ESP_HOSTED_CP_TARGET_ESP32C5=y
CONFIG_ESP_HOSTED_P4_DEV_BOARD_NONE=y
CONFIG_ESP_HOSTED_SDIO_SLOT_1=y
CONFIG_ESP_HOSTED_HOST_SDIO_PIN_CLK=18
CONFIG_ESP_HOSTED_HOST_SDIO_PIN_CMD=19
CONFIG_ESP_HOSTED_HOST_SDIO_PIN_D0=14
CONFIG_ESP_HOSTED_HOST_SDIO_PIN_D1=15
CONFIG_ESP_HOSTED_HOST_SDIO_PIN_D2=16
CONFIG_ESP_HOSTED_HOST_SDIO_PIN_D3=17
CONFIG_ESP_HOSTED_HOST_RESET_GPIO=54
CONFIG_EH_HOST_PORT_DMA_PREFER_SPIRAM=y
CONFIG_WIFI_RMT_STATIC_RX_BUFFER_NUM=16
CONFIG_WIFI_RMT_DYNAMIC_RX_BUFFER_NUM=64
CONFIG_WIFI_RMT_DYNAMIC_TX_BUFFER_NUM=64
CONFIG_WIFI_RMT_AMPDU_TX_ENABLED=y
CONFIG_WIFI_RMT_TX_BA_WIN=32
CONFIG_WIFI_RMT_AMPDU_RX_ENABLED=y
CONFIG_WIFI_RMT_RX_BA_WIN=32

# lwip
CONFIG_LWIP_TCP_SND_BUF_DEFAULT=65534
CONFIG_LWIP_TCP_WND_DEFAULT=65534
CONFIG_LWIP_TCP_RECVMBOX_SIZE=64
CONFIG_LWIP_UDP_RECVMBOX_SIZE=64
CONFIG_LWIP_TCPIP_RECVMBOX_SIZE=64
CONFIG_LWIP_TCP_SACK_OUT=y

CONFIG_COMPILER_DISABLE_DEFAULT_ERRORS=y
CONFIG_SR_WN_WN9S_NIHAOXIAOZHI=y
CONFIG_FREERTOS_TASK_CREATE_ALLOW_EXT_MEM=y
CONFIG_XIAOZHI_SYNC_SYSTEM_TIME_FROM_SERVER=n
```
